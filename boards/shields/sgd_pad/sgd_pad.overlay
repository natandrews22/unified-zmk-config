/ {
    chosen {
        zmk,kscan = &kscan0;
    };

    kscan0: kscan {
        compatible = "zmk,kscan-gpio-matrix";

        diode-direction = "col2row";

        row-gpios = <
            &gpio0 17 (GPIO_ACTIVE_HIGH | GPIO_PULL_DOWN)
            &gpio0 20 (GPIO_ACTIVE_HIGH | GPIO_PULL_DOWN)
            &gpio0 24 (GPIO_ACTIVE_HIGH | GPIO_PULL_DOWN)
            &gpio0 29 (GPIO_ACTIVE_HIGH | GPIO_PULL_DOWN)
        >;

        col-gpios = <
            &gpio0 11 (GPIO_ACTIVE_HIGH)
            &gpio0 2 (GPIO_ACTIVE_HIGH)
            &gpio0 22 (GPIO_ACTIVE_HIGH)
        >;
    };
};